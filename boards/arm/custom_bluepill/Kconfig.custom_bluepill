## boards/arm/custom_bluepill/Kconfig.custom_bluepill
```kconfig
# STM32 Minimum Development Board Configuration

# Copyright (c) 2017, embedjournal.com
# SPDX-License-Identifier: Apache-2.0

config BOARD_CUSTOM_BLUEPILL
	select SOC_STM32F103X8
```

## boards/arm/custom_bluepill/board.yml
```yaml
board:
  name: custom_bluepill
  full_name: STM32F103C8T6 Minimum Development Board
  vendor: st
  socs:
    - name: stm32f103xb
```
